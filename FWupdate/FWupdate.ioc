# file: FWupdate.ioc
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Mcu.Family=STM32F4
Mcu.Name=STM32F411V(C-E)Tx
Mcu.Package=LQFP100
NVIC.PriorityGroup=NVIC_PRIORITYGROUP_4
PA13.Mode=Serial_Wire
PA13.Signal=SYS_JTMS-SWDIO
PA14.Mode=Serial_Wire
PA14.Signal=SYS_JTCK-SWCLK
ProjectManager.HeapSize=0x200
ProjectManager.StackSize=0x400
ProjectManager.TargetToolchain=STM32CubeIDE
RCC.AHBFreq_Value=16000000
RCC.APB1Freq_Value=16000000
RCC.APB2Freq_Value=16000000
RCC.CortexFreq_Value=16000000
RCC.HSE_VALUE=25000000
RCC.HSI_VALUE=16000000
RCC.LSE_VALUE=32768
RCC.SYSCLKFreq_VALUE=16000000
RCC.VCOOutputFreq_Value=192000000
board=custom

// file: Core/Src/main.c
/* USER CODE BEGIN Header */
/**
  ******************************************************************************
  * @file           : main.c
  * @brief          : Main program body
  ******************************************************************************
  * @attention
  *
  * Copyright (c) 2026 STMicroelectronics.
  * All rights reserved.
  *
  * This software is licensed under terms that can be found in the LICENSE file
  * in the root directory of this software component.
  * If no LICENSE file comes with this software, it is provided AS-IS.
  *
  ******************************************************************************
  */
/* USER CODE END Header */
#include "main.h"
#include "string.h"
#include <stdio.h>

/* USER CODE BEGIN PD */
char rev_data[16000] = {0};
/* USER CODE END PD */

void SystemClock_Config(void);
static void MX_GPIO_Init(void);
void flash_erase_sector(char sector);
void flash_program(uint8_t *addr, uint8_t data);
void uart_init(void);
void transmit_1char(char data);
void transmit_string(char* data);
uint8_t recive_char(void);
void update_firmware(char addr_data[],int sizeof_data);

int main(void)
{

  /* MCU Configuration--------------------------------------------------------*/

  /* Reset of all peripherals, Initializes the Flash interface and the Systick. */
  HAL_Init();

  /* Configure the system clock */
  SystemClock_Config();

  /* Initialize all configured peripherals */
  MX_GPIO_Init();
  uart_init();
  transmit_string("st-link new firmware\n");
  int i = 0;
  while(strstr(rev_data,"\n")==NULL)
  {
	  rev_data[i++] = recive_char();
  }
  transmit_string("Please send firmware\n");
  int fw_size;
  sscanf(rev_data,"%d\n",&fw_size);
  for(int i = 0;i<fw_size;i++)
  {
	  rev_data[i]=recive_char();
  }
  update_firmware(rev_data,fw_size);

  /* Infinite loop */
  while (1)
  {

  }
}

void SystemClock_Config(void)
{
  RCC_OscInitTypeDef RCC_OscInitStruct = {0};
  RCC_ClkInitTypeDef RCC_ClkInitStruct = {0};

  /** Configure the main internal regulator output voltage
  */
  __HAL_RCC_PWR_CLK_ENABLE();
  __HAL_PWR_VOLTAGESCALING_CONFIG(PWR_REGULATOR_VOLTAGE_SCALE1);

  /** Initializes the RCC Oscillators according to the specified parameters
  * in the RCC_OscInitTypeDef structure.
  */
  RCC_OscInitStruct.OscillatorType = RCC_OSCILLATORTYPE_HSI;
  RCC_OscInitStruct.HSIState = RCC_HSI_ON;
  RCC_OscInitStruct.HSICalibrationValue = RCC_HSICALIBRATION_DEFAULT;
  RCC_OscInitStruct.PLL.PLLState = RCC_PLL_NONE;
  if (HAL_RCC_OscConfig(&RCC_OscInitStruct) != HAL_OK)
  {
    Error_Handler();
  }

  /** Initializes the CPU, AHB and APB buses clocks
  */
  RCC_ClkInitStruct.ClockType = RCC_CLOCKTYPE_HCLK|RCC_CLOCKTYPE_SYSCLK
                              |RCC_CLOCKTYPE_PCLK1|RCC_CLOCKTYPE_PCLK2;
  RCC_ClkInitStruct.SYSCLKSource = RCC_SYSCLKSOURCE_HSI;
  RCC_ClkInitStruct.AHBCLKDivider = RCC_SYSCLK_DIV1;
  RCC_ClkInitStruct.APB1CLKDivider = RCC_HCLK_DIV1;
  RCC_ClkInitStruct.APB2CLKDivider = RCC_HCLK_DIV1;

  if (HAL_RCC_ClockConfig(&RCC_ClkInitStruct, FLASH_LATENCY_0) != HAL_OK)
  {
    Error_Handler();
  }
}
__attribute__((section(".RamFunc"))) void flash_erase_sector(char sector)
{
	while(((FLASH->CR>>FLASH_CR_LOCK_Pos)&1)==1){
		FLASH->KEYR = 0x45670123;
		FLASH->KEYR = 0xCDEF89AB;
	}// unlock FLASH_Register
	//sequence erase sector
	while(((FLASH->SR>>FLASH_SR_BSY_Pos)&1)==1){}//check bit BSY
	FLASH->CR |=(FLASH_CR_SER);
	FLASH->CR &=~(0b111<<FLASH_CR_SNB_Pos);
	FLASH->CR |= (sector<<FLASH_CR_SNB_Pos);
	FLASH->CR |= (FLASH_CR_STRT);

}
__attribute__((section(".RamFunc"))) void flash_program(uint8_t *addr, uint8_t data)
{
	while(((FLASH->CR>>FLASH_CR_LOCK_Pos)&1)==1){
		FLASH->KEYR = 0x45670123;
		FLASH->KEYR = 0xCDEF89AB;
	}// unlock FLASH_Register
	//sequence program flash address
	while(((FLASH->SR>>FLASH_SR_BSY_Pos)&1)==1){} //check bit BSY
	FLASH->CR &=~(0xf<<FLASH_CR_PSIZE_Pos);
	FLASH->CR |= (0b00<<FLASH_CR_PSIZE_Pos);// only write 1byte =8bit
	FLASH->CR |=(FLASH_CR_PG);
	*addr = data;
	while(((FLASH->SR>>FLASH_SR_BSY_Pos)&1)==1){}
}
void uart_init()
{
 // PD5(TX-AF07) PD6(RX-AF07)
	__HAL_RCC_GPIOD_CLK_ENABLE();
	__HAL_RCC_USART2_CLK_ENABLE();
	GPIOD->MODER &=~(0xf<<10);
	GPIOD->MODER |= (0b1010<<10);
	GPIOD->AFR[0] &=~(0xff<<20);
	GPIOD->AFR[0] |= (0b01110111<<20);
	USART2->BRR = (104<<4)|3;
	USART2->CR1 &=~(USART_CR1_M|USART_CR1_PCE);
	USART2->CR1 |= (USART_CR1_TE|USART_CR1_RE|USART_CR1_UE);
	//enable interrupt uart2 recive
}
void transmit_1char(char data)
{
	while (!(USART2->SR & (1 << 7))){}
	USART2->DR = data;
	while (!(USART2->SR & (1 << 6))){}
	USART2->SR &=~(1<<6);
}
void transmit_string(char* data)
{
	int datalen = strlen(data);
	for(int i = 0; i<datalen; i++)
	{
		transmit_1char(data[i]);
	}
}
uint8_t recive_char()
{
    while (!(USART2->SR & USART_SR_RXNE)){}
    return (uint8_t)(USART2->DR & 0xFF);
}
__attribute__((section(".RamFunc"))) void update_firmware(char addr_data[],int sizeof_data)
{
	SysTick->CTRL &=~1;
	flash_erase_sector(0);
	for(int i = 0;i<sizeof_data;i++)
	{
		flash_program((uint8_t*)(0x08000000+i),addr_data[i]);
	}
	SCB->AIRCR=(0x5FA<<SCB_AIRCR_VECTKEY_Pos)|(1<<SCB_AIRCR_SYSRESETREQ_Pos);
}
static void MX_GPIO_Init(void)
{

  /* GPIO Ports Clock Enable */
  __HAL_RCC_GPIOA_CLK_ENABLE();

}

void Error_Handler(void)
{
  __disable_irq();
  while (1)
  {
  }
}
